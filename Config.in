## Config.in
```kconfig
source "$BR2_EXTERNAL_RTONE_PATH/package/raspberrypi-firmware-rauc-bootloader-backend/Config.in"
source "$BR2_EXTERNAL_RTONE_PATH/package/raspberrypi-firmware-systemd-generator/Config.in"
source "$BR2_EXTERNAL_RTONE_PATH/package/rpi-eeprom/Config.in"
```

## configs/qemu_x86_64_efi_defconfig
```kconfig
BR2_x86_64=y
BR2_TOOLCHAIN_EXTERNAL=y
BR2_GLOBAL_PATCH_DIR="board/qemu/patches"
BR2_DOWNLOAD_FORCE_CHECK_HASHES=y
BR2_INIT_SYSTEMD=y
BR2_SYSTEM_DHCP="enp0s3"
BR2_SYSTEM_DEFAULT_PATH="/bin:/sbin:/usr/bin:/usr/sbin"
BR2_ROOTFS_OVERLAY="$(BR2_EXTERNAL_RTONE_PATH)/board/qemu/overlay"
BR2_ROOTFS_POST_BUILD_SCRIPT="$(BR2_EXTERNAL_RTONE_PATH)/board/qemu/post-build.sh board/qemu/x86_64/post-build.sh"
BR2_ROOTFS_POST_IMAGE_SCRIPT="$(BR2_EXTERNAL_RTONE_PATH)/board/qemu/post-image.sh support/scripts/genimage.sh"
BR2_ROOTFS_POST_SCRIPT_ARGS="$(BR2_DEFCONFIG)"
BR2_ROOTFS_POST_IMAGE_SCRIPT_ARGS="-c $(BR2_EXTERNAL_RTONE_PATH)/board/qemu/genimage.cfg"
BR2_LINUX_KERNEL=y
BR2_LINUX_KERNEL_CUSTOM_VERSION=y
BR2_LINUX_KERNEL_CUSTOM_VERSION_VALUE="6.12.9"
BR2_LINUX_KERNEL_USE_CUSTOM_CONFIG=y
BR2_LINUX_KERNEL_CUSTOM_CONFIG_FILE="board/qemu/x86_64/linux.config"
BR2_LINUX_KERNEL_CONFIG_FRAGMENT_FILES="$(BR2_EXTERNAL_RTONE_PATH)/board/qemu/x86_64-efi/linux.config"
BR2_LINUX_KERNEL_INSTALL_TARGET=y
BR2_LINUX_KERNEL_NEEDS_HOST_LIBELF=y
BR2_PACKAGE_SYSTEMD_REPART=y
BR2_TARGET_ROOTFS_EXT2=y
BR2_TARGET_ROOTFS_EXT2_4=y
BR2_TARGET_ROOTFS_EXT2_SIZE="80M"
# BR2_TARGET_ROOTFS_TAR is not set
BR2_TARGET_EDK2=y
BR2_TARGET_GRUB2=y
BR2_TARGET_GRUB2_X86_64_EFI=y
BR2_PACKAGE_HOST_GENIMAGE=y
BR2_PACKAGE_HOST_QEMU=y
BR2_PACKAGE_HOST_QEMU_SYSTEM_MODE=y
```

## configs/raspberrypi4_64_defconfig
```kconfig
BR2_aarch64=y
BR2_cortex_a72=y
BR2_ARM_FPU_VFPV4=y
BR2_TOOLCHAIN_EXTERNAL=y
BR2_TOOLCHAIN_EXTERNAL_BOOTLIN=y
BR2_INIT_SYSTEMD=y
BR2_SYSTEM_BIN_SH_BASH=y
# BR2_TARGET_GENERIC_REMOUNT_ROOTFS_RW is not set
BR2_SYSTEM_DHCP="end0"
BR2_SYSTEM_DEFAULT_PATH="/bin:/sbin:/usr/bin:/usr/sbin"
BR2_ROOTFS_OVERLAY="$(BR2_EXTERNAL_RTONE_PATH)/board/raspberrypi/overlay"
BR2_ROOTFS_POST_BUILD_SCRIPT="board/raspberrypi/post-build.sh"
BR2_ROOTFS_POST_IMAGE_SCRIPT="$(BR2_EXTERNAL_RTONE_PATH)/board/raspberrypi/post-image4.sh"
BR2_LINUX_KERNEL=y
BR2_LINUX_KERNEL_CUSTOM_TARBALL=y
BR2_LINUX_KERNEL_CUSTOM_TARBALL_LOCATION="$(call github,raspberrypi,linux,17f135b742c4edb340afb365873c3a574f7e16cb)/linux-17f135b742c4edb340afb365873c3a574f7e16cb.tar.gz"
BR2_LINUX_KERNEL_DEFCONFIG="bcm2711"
BR2_LINUX_KERNEL_DTS_SUPPORT=y
BR2_LINUX_KERNEL_INTREE_DTS_NAME="broadcom/bcm2711-rpi-4-b"
BR2_LINUX_KERNEL_NEEDS_HOST_OPENSSL=y
BR2_PACKAGE_XZ=y
BR2_PACKAGE_DOSFSTOOLS=y
BR2_PACKAGE_DOSFSTOOLS_FSCK_FAT=y
BR2_PACKAGE_RPI_FIRMWARE=y
BR2_PACKAGE_RPI_FIRMWARE_VARIANT_PI4=y
BR2_PACKAGE_RPI_FIRMWARE_CONFIG_FILE="$(BR2_EXTERNAL_RTONE_PATH)/board/raspberrypi/config4.txt"
BR2_PACKAGE_RPI_FIRMWARE_CMDLINE_FILE=""
BR2_PACKAGE_DROPBEAR=y
BR2_PACKAGE_OPENSSH=y
# BR2_PACKAGE_OPENSSH_CLIENT is not set
# BR2_PACKAGE_OPENSSH_SANDBOX is not set
BR2_PACKAGE_RAUC=y
BR2_PACKAGE_RAUC_DBUS=y
BR2_PACKAGE_RAUC_GPT=y
BR2_PACKAGE_RAUC_NETWORK=y
BR2_PACKAGE_RAUC_STREAMING=y
BR2_TARGET_ROOTFS_EXT2=y
BR2_TARGET_ROOTFS_EXT2_4=y
BR2_TARGET_ROOTFS_EXT2_SIZE="256M"
# BR2_TARGET_ROOTFS_TAR is not set
BR2_PACKAGE_HOST_BMAP_TOOLS=y
BR2_PACKAGE_HOST_DOSFSTOOLS=y
BR2_PACKAGE_HOST_GENIMAGE=y
BR2_PACKAGE_HOST_KMOD_XZ=y
BR2_PACKAGE_HOST_MTOOLS=y
BR2_PACKAGE_HOST_RAUC=y
BR2_PACKAGE_RASPBERRYPI_FIRMWARE_RAUC_BOOTLOADER_BACKEND=y
BR2_PACKAGE_RASPBERRYPI_FIRMWARE_SYSTEMD_GENERATOR=y
BR2_PACKAGE_RPI_EEPROM=y
BR2_PACKAGE_RPI_EEPROM_BCM2711=y
```

## package/raspberrypi-firmware-rauc-bootloader-backend/Config.in
```kconfig
config BR2_PACKAGE_RASPBERRYPI_FIRMWARE_RAUC_BOOTLOADER_BACKEND
	bool "raspberrypi-firmware-rauc-bootloader-backend"
	depends on !BR2_STATIC_LIBS # dtc
	depends on BR2_PACKAGE_BUSYBOX_SHOW_OTHERS # bash
	depends on BR2_USE_MMU # bash
	select BR2_PACKAGE_BASH # runtime
	select BR2_PACKAGE_DTC # dtc-programs
	select BR2_PACKAGE_DTC_PROGRAMS # runtime (fdtget)
	help
	  An implementation of a RAUC custom bootloader backend for the
	  Raspberry Pi firmware.

	  https://www.portay.io/raspberrypi-firmware-rauc-bootloader-backend/
```

## package/raspberrypi-firmware-systemd-generator/Config.in
```kconfig
config BR2_PACKAGE_RASPBERRYPI_FIRMWARE_SYSTEMD_GENERATOR
	bool "raspberrypi-firmware-systemd-generator"
	depends on BR2_PACKAGE_BUSYBOX_SHOW_OTHERS # bash
	depends on BR2_USE_MMU # bash
	select BR2_PACKAGE_BASH # runtime
	help
	  A systemd-generator for mounting the bootloader partitions of
	  the Raspberry Pi firmware.

	  https://www.portay.io/raspberrypi-firmware-systemd-generator/
```

## package/rpi-eeprom/Config.in
```kconfig
config BR2_PACKAGE_RPI_EEPROM
	bool "rpi-eeprom"
	depends on BR2_arm || BR2_aarch64
	select BR2_PACKAGE_FLASHROM # runtime
	select BR2_PACKAGE_LIBOPENSSL_BIN # runtime
	select BR2_PACKAGE_PYTHON3 # runtime
	select BR2_PACKAGE_RPI_USERLAND # runetime (vcgencmd)
	help
	  Installation scripts and binaries for the Raspberry Pi 4
	  and Raspberry Pi 5 bootloader EEPROMs.

	  https://github.com/raspberrypi/rpi-eeprom

if BR2_PACKAGE_RPI_EEPROM

config BR2_PACKAGE_RPI_EEPROM_BCM2711
	bool "bcm2711 (pi4/400, cm4/4s)"
	select BR2_PACKAGE_PCIUTILS
	help
	  The default set of firmwares for bcm2711.

config BR2_PACKAGE_RPI_EEPROM_BCM2712
	bool "bcm2712 (pi5/500, cm5)"
	help
	  The default set of firmwares for bcm2712.

endif # BR2_PACKAGE_RPI_EEPROM
```
